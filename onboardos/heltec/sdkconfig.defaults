## onboardos/heltec/sdkconfig.defaults
```kconfig
# 1. Core Bluetooth
CONFIG_BT_ENABLED=y
CONFIG_BT_BLUEDROID_ENABLED=y
CONFIG_BT_CONTROLLER_ENABLED=y

# 2. ESP32-S3 Specific: Force BLE Only
CONFIG_BTDM_CTRL_MODE_BLE_ONLY=y
CONFIG_BTDM_CTRL_MODE_BR_EDR_ONLY=n
CONFIG_BTDM_CTRL_MODE_BTDM=n

# 3. CRITICAL: Force Legacy (4.2) Features by disabling 5.0
# The S3 defaults to 5.0. We must turn it OFF to get the Legacy functions back.
CONFIG_BT_BLE_50_FEATURES_SUPPORTED=n
CONFIG_BT_BLE_42_FEATURES_SUPPORTED=y

# 4. Filesystem
CONFIG_FATFS_LFN_HEAP=y
CONFIG_FATFS_MAX_LFN=255
```

## onboardos/supermini/sdkconfig.defaults
```kconfig
# Force esptool to use the internal USB port
CONFIG_ESP_CONSOLE_USB_SERIAL_JTAG=y

# Fix the flash size for your SuperMini
CONFIG_ESPTOOLPY_FLASHSIZE_4MB=y

# Core Bluetooth
CONFIG_BT_ENABLED=y
CONFIG_BT_BLUEDROID_ENABLED=y
CONFIG_BT_CONTROLLER_ENABLED=y

# ESP32-S3 Specific: Force BLE Only
CONFIG_BTDM_CTRL_MODE_BLE_ONLY=y
CONFIG_BTDM_CTRL_MODE_BR_EDR_ONLY=n
CONFIG_BTDM_CTRL_MODE_BTDM=n

# Force Legacy (4.2) Features by disabling 5.0
CONFIG_BT_BLE_50_FEATURES_SUPPORTED=n
CONFIG_BT_BLE_42_FEATURES_SUPPORTED=y

# Filesystem (Allows long file names)
CONFIG_FATFS_LFN_HEAP=y
CONFIG_FATFS_MAX_LFN=255
```
